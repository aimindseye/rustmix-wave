## sdkconfig.defaults
```kconfig
# Rust main task: leave margin for rendering and log formatting.
CONFIG_ESP_MAIN_TASK_STACK_SIZE=16384
CONFIG_ESP_SYSTEM_EVENT_TASK_STACK_SIZE=4096
CONFIG_FREERTOS_IDLE_TASK_STACKSIZE=4096
CONFIG_PTHREAD_TASK_STACK_SIZE_DEFAULT=4096

# Waveshare ESP32-S3-WROOM-1-N16R8 module: 16 MB flash, octal PSRAM.
CONFIG_ESPTOOLPY_FLASHSIZE_16MB=y
CONFIG_SPIRAM=y
CONFIG_SPIRAM_MODE_OCT=y
CONFIG_SPIRAM_SPEED_80M=y
CONFIG_SPIRAM_USE_MALLOC=y
CONFIG_SPIRAM_MALLOC_ALWAYSINTERNAL=16384
CONFIG_SPIRAM_MALLOC_RESERVE_INTERNAL=32768

# Embed a semantic product milestone version in the ESP-IDF app descriptor.
CONFIG_APP_PROJECT_VER_FROM_CONFIG=y
CONFIG_APP_PROJECT_VER="1.0.0"

# Wi-Fi/SNTP milestone defaults.
CONFIG_LWIP_SNTP_MAX_SERVERS=1
CONFIG_LWIP_SNTP_UPDATE_DELAY=3600000

# HTTPS weather retrieval uses the ESP-IDF certificate bundle.
CONFIG_MBEDTLS_CERTIFICATE_BUNDLE=y
CONFIG_MBEDTLS_DEFAULT_CERTIFICATE_BUNDLE=y

# Embedded browser requests commonly exceed the ESP-IDF 512-byte default.
CONFIG_HTTPD_MAX_REQ_HDR_LEN=1024
```

## sdkconfig.defaults.rustmix-remote-ble
```kconfig
# Optional Rustmix Remote BLE GATT r1 defaults.
# Apply only for BLE test builds. The normal sdkconfig.defaults remains Wi-Fi-first.
# Based on the esp-idf-svc Bluedroid GATT server example recommendations.
CONFIG_BT_ENABLED=y
CONFIG_BT_BLUEDROID_ENABLED=y
CONFIG_BT_CLASSIC_ENABLED=n
CONFIG_BTDM_CTRL_MODE_BLE_ONLY=y
CONFIG_BTDM_CTRL_MODE_BR_EDR_ONLY=n
CONFIG_BTDM_CTRL_MODE_BTDM=n
CONFIG_BT_BLE_42_FEATURES_SUPPORTED=y
CONFIG_BT_BLE_50_FEATURES_SUPPORTED=n
CONFIG_BT_BTC_TASK_STACK_SIZE=15000
CONFIG_BT_BLE_DYNAMIC_ENV_MEMORY=y

CONFIG_BLUEDROID_ENABLED=y

CONFIG_BT_BLE_ENABLED=y
```

## target-waveshare-epd397/sdkconfig.defaults
```kconfig
CONFIG_ESPTOOLPY_FLASHSIZE_16MB=y
CONFIG_ESPTOOLPY_FLASHSIZE="16MB"
CONFIG_FREERTOS_HZ=1000
```
